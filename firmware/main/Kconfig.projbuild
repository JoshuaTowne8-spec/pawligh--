## firmware/main/Kconfig.projbuild
```kconfig
menu "Pet emotion lamp"

config PET_WIFI_SSID
    string "Wi-Fi SSID"
    default ""

config PET_WIFI_PASSWORD
    string "Wi-Fi password"
    default ""

config PET_GATEWAY_URI
    string "Emotion gateway WebSocket URI"
    default "ws://192.168.18.49:8080/v1/device/audio"

config PET_DEVICE_TOKEN
    string "Device token (must match gateway/.env)"
    default ""

config PET_LED_CHAINED
    bool "Two LED rows are daisy-chained as in the product photo"
    default n
    help
        Enable when row A DOUT is already connected to row B DIN and there is
        only one three-wire input plug. Both rows then use GPIO4 as one strip.

config PET_LED_COUNT_A
    int "LED count in row A"
    range 1 300
    default 30

config PET_LED_COUNT_B
    int "LED count in row B"
    range 1 300
    default 60

config PET_LED_BRIGHTNESS
    int "Maximum LED brightness (0-255)"
    range 1 128
    default 64
    help
        64 is approximately 25 percent brightness and is a safe prototype
        default for power and heat.

config PET_MIC_GAIN
    int "INMP441 digital gain"
    range 1 16
    default 4

config PET_VOICE_RMS_THRESHOLD
    int "Local voice detection RMS threshold"
    range 50 5000
    default 300
    help
        Three consecutive 40 ms audio frames above this RMS value count as
        speech and restart the calm-light silence timer. Increase this value
        if touching the enclosure is mistaken for speech; decrease it if soft
        speech is not detected.

endmenu
```

## firmware/sdkconfig.defaults
```kconfig
CONFIG_ESP_MAIN_TASK_STACK_SIZE=8192
CONFIG_ESP_SYSTEM_EVENT_TASK_STACK_SIZE=4096
CONFIG_MBEDTLS_CERTIFICATE_BUNDLE=y
CONFIG_COMPILER_OPTIMIZATION_PERF=y
```
